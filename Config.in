## Config.in
```kconfig
menu "Swift runtime"

	source "$BR2_EXTERNAL_SWIFT_PATH/package/swift/Config.in"
	source "$BR2_EXTERNAL_SWIFT_PATH/package/libswiftdispatch/Config.in"
    source "$BR2_EXTERNAL_SWIFT_PATH/package/swift-foundation/Config.in"

endmenu

menu "Swift libraries"

	source "$BR2_EXTERNAL_SWIFT_PATH/package/xctest/Config.in"
	source "$BR2_EXTERNAL_SWIFT_PATH/package/swift-system/Config.in"
	source "$BR2_EXTERNAL_SWIFT_PATH/package/swift-asn1/Config.in"
	source "$BR2_EXTERNAL_SWIFT_PATH/package/swift-crypto/Config.in"

endmenu

menu "Swift Tools"

	source "$BR2_EXTERNAL_SWIFT_PATH/package/swift-hello/Config.in"

endmenu
```

## package/swift-asn1/Config.in
```kconfig
if BR2_PACKAGE_SWIFT

config BR2_PACKAGE_SWIFT_ASN1
	bool "swift-asn1"
	depends on BR2_PACKAGE_SWIFT
	select BR2_PACKAGE_SWIFT_FOUNDATION
	help
	  SwiftASN1 is an implementation of ASN.1 types and DER/BER
	  serialization in Swift. It is a dependency of swift-crypto.

	  https://github.com/apple/swift-asn1

endif
```

## package/swift-atomics/Config.in
```kconfig
if BR2_PACKAGE_SWIFT

config BR2_PACKAGE_SWIFT_ATOMICS
	bool "swift-atomics"
	depends on BR2_PACKAGE_SWIFT
	help
	  Swift Atomics provides low-level atomic operations for Swift (the
	  Atomics module).

	  https://github.com/apple/swift-atomics

endif
```

## package/swift-collections/Config.in
```kconfig
if BR2_PACKAGE_SWIFT

config BR2_PACKAGE_SWIFT_COLLECTIONS
	bool "swift-collections"
	depends on BR2_PACKAGE_SWIFT
	help
	  Swift Collections is a package of production-grade data structures
	  (the Collections umbrella module: DequeModule, OrderedCollections,
	  BitCollections, HeapModule, ...).

	  https://github.com/apple/swift-collections

endif
```

## package/swift-crypto/Config.in
```kconfig
if BR2_PACKAGE_SWIFT

config BR2_PACKAGE_SWIFT_CRYPTO
	bool "swift-crypto"
	depends on BR2_PACKAGE_SWIFT
	select BR2_PACKAGE_SWIFT_FOUNDATION
	select BR2_PACKAGE_SWIFT_ASN1
	help
	  Swift Crypto is the open-source implementation of Apple's CryptoKit
	  API (the Crypto module). It vendors and statically links BoringSSL, so
	  it needs no system OpenSSL. On architectures for which BoringSSL ships
	  no assembly it is built as portable C (OPENSSL_NO_ASM).

	  https://github.com/apple/swift-crypto

endif
```

## package/swift-http-types/Config.in
```kconfig
if BR2_PACKAGE_SWIFT

config BR2_PACKAGE_SWIFT_HTTP_TYPES
	bool "swift-http-types"
	depends on BR2_PACKAGE_SWIFT
	select BR2_PACKAGE_SWIFT_FOUNDATION
	help
	  Swift HTTP Types provides version-independent HTTP currency types
	  (the HTTPTypes and HTTPTypesFoundation modules).

	  https://github.com/apple/swift-http-types

endif
```

## package/swift-numerics/Config.in
```kconfig
if BR2_PACKAGE_SWIFT

config BR2_PACKAGE_SWIFT_NUMERICS
	bool "swift-numerics"
	depends on BR2_PACKAGE_SWIFT
	help
	  Swift Numerics provides numerical computing modules for Swift
	  (Numerics, RealModule, ComplexModule).

	  https://github.com/apple/swift-numerics

endif
```

## package/swift-system/Config.in
```kconfig
if BR2_PACKAGE_SWIFT

config BR2_PACKAGE_SWIFT_SYSTEM
	bool "swift-system"
	depends on BR2_PACKAGE_SWIFT
	help
	  Swift System provides idiomatic interfaces to system calls and
	  low-level currency types (the SystemPackage module: FilePath,
	  Errno, FileDescriptor, ...).

	  https://github.com/apple/swift-system

endif
```
