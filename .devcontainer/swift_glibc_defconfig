## .devcontainer/swift_glibc_defconfig
```kconfig
# GNU C Toolchain
BR2_KERNEL_HEADERS_4_19=y
BR2_TOOLCHAIN_BUILDROOT_GLIBC=y
BR2_TOOLCHAIN_BUILDROOT_CXX=y

# Vendor
BR2_TOOLCHAIN_BUILDROOT_VENDOR="swift"
BR2_TARGET_GENERIC_HOSTNAME="swift-linux"
BR2_TARGET_GENERIC_ISSUE="Welcome to Swift Linux"
```

## configs/aarch64_efi_swift_defconfig
```kconfig
# Architecture
BR2_aarch64=y

# System
BR2_ROOTFS_DEVICE_CREATION_DYNAMIC_EUDEV=y

## Required tools to create bootable media
BR2_PACKAGE_HOST_GENIMAGE=y

# Bootloader
BR2_TARGET_GRUB2=y
BR2_TARGET_GRUB2_ARM64_EFI=y

# Filesystem / image
BR2_TARGET_ROOTFS_EXT2=y
BR2_TARGET_ROOTFS_EXT2_4=y
BR2_TARGET_ROOTFS_EXT2_SIZE="512M"
# BR2_TARGET_ROOTFS_TAR is not set
BR2_ROOTFS_POST_IMAGE_SCRIPT="board/aarch64-efi/post-image.sh support/scripts/genimage.sh"
BR2_ROOTFS_POST_SCRIPT_ARGS="-c board/aarch64-efi/genimage-efi.cfg"

# Linux headers same as kernel, a 5.15 series
BR2_PACKAGE_HOST_LINUX_HEADERS_CUSTOM_5_15=y

# Kernel
BR2_LINUX_KERNEL=y
BR2_LINUX_KERNEL_CUSTOM_VERSION=y
BR2_LINUX_KERNEL_CUSTOM_VERSION_VALUE="5.15.4"
BR2_LINUX_KERNEL_USE_ARCH_DEFAULT_CONFIG=y
BR2_LINUX_KERNEL_NEEDS_HOST_OPENSSL=y

# Host tools for genimage
BR2_PACKAGE_HOST_DOSFSTOOLS=y
BR2_PACKAGE_HOST_MTOOLS=y

# GNU C Toolchain
BR2_KERNEL_HEADERS_4_14=y
BR2_TOOLCHAIN_BUILDROOT_GLIBC=y
BR2_TOOLCHAIN_BUILDROOT_CXX=y

# Vendor
BR2_TOOLCHAIN_BUILDROOT_VENDOR="swift"
BR2_TARGET_GENERIC_HOSTNAME="swift-linux"
BR2_TARGET_GENERIC_ISSUE="Welcome to Swift Linux"

# Swift Runtime Libraries
BR2_PACKAGE_LIBDISPATCH=y
BR2_PACKAGE_SWIFT=y
BR2_PACKAGE_LIBSWIFTDISPATCH=y
BR2_PACKAGE_FOUNDATION=y

# Dependencies
BR2_PACKAGE_ICU=y
BR2_PACKAGE_LIBBSD=y
BR2_PACKAGE_LIBMD=y
BR2_PACKAGE_LIBXML2=y
BR2_PACKAGE_LIBCURL=y
BR2_PACKAGE_OPENSSL=y
```

## configs/imx6slevk_swift_defconfig
```kconfig
BR2_arm=y
BR2_cortex_a9=y
BR2_ARM_ENABLE_NEON=y
BR2_ARM_ENABLE_VFP=y
BR2_ARM_FPU_VFPV3=y
# Linux headers same as kernel, a 5.15 series
BR2_PACKAGE_HOST_LINUX_HEADERS_CUSTOM_5_15=y
BR2_TARGET_GENERIC_GETTY_PORT="ttymxc0"
BR2_TARGET_ROOTFS_EXT2=y
BR2_TARGET_ROOTFS_EXT2_4=y
BR2_TARGET_UBOOT=y
BR2_TARGET_UBOOT_BOARDNAME="mx6slevk"
BR2_TARGET_UBOOT_CUSTOM_VERSION=y
BR2_TARGET_UBOOT_CUSTOM_VERSION_VALUE="2021.10"
BR2_TARGET_UBOOT_NEEDS_OPENSSL=y
BR2_TARGET_UBOOT_FORMAT_IMX=y
BR2_LINUX_KERNEL=y
BR2_LINUX_KERNEL_CUSTOM_VERSION=y
BR2_LINUX_KERNEL_CUSTOM_VERSION_VALUE="5.15.11"
BR2_LINUX_KERNEL_DEFCONFIG="imx_v6_v7"
BR2_LINUX_KERNEL_DTS_SUPPORT=y
BR2_LINUX_KERNEL_INTREE_DTS_NAME="imx6sl-evk"
BR2_ROOTFS_POST_IMAGE_SCRIPT="board/freescale/common/imx/post-image.sh"
# required tools to create the SD card image
BR2_PACKAGE_HOST_DOSFSTOOLS=y
BR2_PACKAGE_HOST_GENIMAGE=y
BR2_PACKAGE_HOST_MTOOLS=y

# Filesystem
BR2_TARGET_ROOTFS_EXT2=y
BR2_TARGET_ROOTFS_EXT2_4=y
BR2_TARGET_ROOTFS_EXT2_SIZE="512M"

# Device Management
BR2_ROOTFS_DEVICE_CREATION_DYNAMIC_EUDEV=y

# GNU C Toolchain
BR2_KERNEL_HEADERS_4_19=y
BR2_TOOLCHAIN_BUILDROOT_GLIBC=y
BR2_TOOLCHAIN_BUILDROOT_CXX=y

# Vendor
BR2_TOOLCHAIN_BUILDROOT_VENDOR="swift"
BR2_TARGET_GENERIC_HOSTNAME="swift-linux"
BR2_TARGET_GENERIC_ISSUE="Welcome to Swift Linux"

# Swift Runtime Libraries
BR2_PACKAGE_LIBDISPATCH=y
BR2_PACKAGE_SWIFT=y
BR2_PACKAGE_LIBSWIFTDISPATCH=y
BR2_PACKAGE_FOUNDATION=y

# Dependencies
BR2_PACKAGE_ICU=y
BR2_PACKAGE_LIBBSD=y
BR2_PACKAGE_LIBMD=y
BR2_PACKAGE_LIBXML2=y
BR2_PACKAGE_LIBCURL=y
BR2_PACKAGE_OPENSSL=y
```

## configs/qemu_mips64r6el_malta_swift_defconfig
```kconfig
# Architecture
BR2_mips64el=y
BR2_mips_64r6=y
BR2_MIPS_NABI64=y

# System
BR2_SYSTEM_DHCP="eth0"

# Filesystem
BR2_TARGET_ROOTFS_EXT2=y
BR2_TARGET_ROOTFS_EXT2_4=y
BR2_TARGET_ROOTFS_EXT2_SIZE="512M"

# Image
BR2_ROOTFS_POST_IMAGE_SCRIPT="board/qemu/post-image.sh"
BR2_ROOTFS_POST_SCRIPT_ARGS="$(BR2_DEFCONFIG)"

# Linux headers same as kernel, a 5.10 series
BR2_PACKAGE_HOST_LINUX_HEADERS_CUSTOM_5_10=y

# Kernel
BR2_LINUX_KERNEL=y
BR2_LINUX_KERNEL_CUSTOM_VERSION=y
BR2_LINUX_KERNEL_CUSTOM_VERSION_VALUE="5.10.7"
BR2_LINUX_KERNEL_USE_CUSTOM_CONFIG=y
BR2_LINUX_KERNEL_CUSTOM_CONFIG_FILE="board/qemu/mips64r6el-malta/linux.config"
BR2_LINUX_KERNEL_VMLINUX=y
BR2_GLOBAL_PATCH_DIR="board/qemu/mips64r6el-malta/patches"

# Serial port config
BR2_TARGET_GENERIC_GETTY=y
BR2_TARGET_GENERIC_GETTY_PORT="ttyS0"

# host-qemu for gitlab testing
BR2_PACKAGE_HOST_QEMU=y
BR2_PACKAGE_HOST_QEMU_SYSTEM_MODE=y

# Device Management
BR2_ROOTFS_DEVICE_CREATION_DYNAMIC_EUDEV=y

# GNU C Toolchain
BR2_TOOLCHAIN_BUILDROOT_GLIBC=y
BR2_TOOLCHAIN_BUILDROOT_CXX=y

# Vendor
BR2_TOOLCHAIN_BUILDROOT_VENDOR="swift"
BR2_TARGET_GENERIC_HOSTNAME="swift-linux"
BR2_TARGET_GENERIC_ISSUE="Welcome to Swift Linux"

# Swift Runtime Libraries
BR2_PACKAGE_LIBDISPATCH=y
BR2_PACKAGE_SWIFT=y

# Dependencies
BR2_PACKAGE_ICU=y
BR2_PACKAGE_LIBBSD=y
BR2_PACKAGE_LIBMD=y
BR2_PACKAGE_LIBXML2=y
BR2_PACKAGE_LIBCURL=y
BR2_PACKAGE_OPENSSL=y
```

## configs/qemu_ppc64le_pseries_swift_defconfig
```kconfig
# Architecture
BR2_powerpc64=y
BR2_powerpc_power7=y

# System
BR2_SYSTEM_DHCP="eth0"
BR2_TARGET_GENERIC_GETTY_PORT="hvc0"

# Filesystem
BR2_TARGET_ROOTFS_EXT2=y
# BR2_TARGET_ROOTFS_TAR is not set

# Image
BR2_ROOTFS_POST_IMAGE_SCRIPT="board/qemu/post-image.sh"
BR2_ROOTFS_POST_SCRIPT_ARGS="$(BR2_DEFCONFIG)"

# Linux headers same as kernel
BR2_PACKAGE_HOST_LINUX_HEADERS_CUSTOM_6_1=y

# Kernel
BR2_LINUX_KERNEL=y
BR2_LINUX_KERNEL_CUSTOM_VERSION=y
BR2_LINUX_KERNEL_CUSTOM_VERSION_VALUE="6.1.44"
BR2_LINUX_KERNEL_DEFCONFIG="pseries"
BR2_LINUX_KERNEL_VMLINUX=y

# host-qemu for gitlab testing
BR2_PACKAGE_HOST_QEMU=y
BR2_PACKAGE_HOST_QEMU_SYSTEM_MODE=y

# Device Management
BR2_ROOTFS_DEVICE_CREATION_DYNAMIC_EUDEV=y

# GNU C Toolchain
BR2_KERNEL_HEADERS_5_15=y
BR2_TOOLCHAIN_BUILDROOT_GLIBC=y
BR2_TOOLCHAIN_BUILDROOT_CXX=y

# Vendor
BR2_TOOLCHAIN_BUILDROOT_VENDOR="swift"
BR2_TARGET_GENERIC_HOSTNAME="swift-linux"
BR2_TARGET_GENERIC_ISSUE="Welcome to Swift Linux"

# Swift Runtime Libraries
BR2_PACKAGE_LIBDISPATCH=y
BR2_PACKAGE_SWIFT=y
BR2_PACKAGE_LIBSWIFTDISPATCH=y
BR2_PACKAGE_FOUNDATION=y

# Dependencies
BR2_PACKAGE_ICU=y
BR2_PACKAGE_LIBBSD=y
BR2_PACKAGE_LIBMD=y
BR2_PACKAGE_LIBXML2=y
BR2_PACKAGE_LIBCURL=y
BR2_PACKAGE_OPENSSL=y
```

## configs/qemu_x86_swift_defconfig
```kconfig
# Architecture
BR2_i386=y
BR2_x86_pentiumpro=y

# System
BR2_SYSTEM_DHCP="eth0"

# Image
BR2_ROOTFS_POST_BUILD_SCRIPT="board/qemu/x86/post-build.sh"

# Image
BR2_ROOTFS_POST_IMAGE_SCRIPT="board/qemu/post-image.sh"
BR2_ROOTFS_POST_SCRIPT_ARGS="$(BR2_DEFCONFIG)"

# Kernel
BR2_LINUX_KERNEL=y
BR2_LINUX_KERNEL_CUSTOM_VERSION=y
BR2_LINUX_KERNEL_CUSTOM_VERSION_VALUE="5.15.18"
BR2_LINUX_KERNEL_USE_CUSTOM_CONFIG=y
BR2_LINUX_KERNEL_CUSTOM_CONFIG_FILE="board/qemu/x86/linux.config"

# host-qemu for gitlab testing
BR2_PACKAGE_HOST_QEMU=y
BR2_PACKAGE_HOST_QEMU_SYSTEM_MODE=y

# Filesystem / image
BR2_TARGET_ROOTFS_EXT2=y
BR2_TARGET_ROOTFS_EXT2_4=y
BR2_TARGET_ROOTFS_EXT2_SIZE="512M"

# Device Management
BR2_ROOTFS_DEVICE_CREATION_DYNAMIC_EUDEV=y

# GNU C Toolchain
BR2_KERNEL_HEADERS_4_9=y
BR2_TOOLCHAIN_BUILDROOT_GLIBC=y
BR2_TOOLCHAIN_BUILDROOT_CXX=y

# Vendor
BR2_TOOLCHAIN_BUILDROOT_VENDOR="swift"
BR2_TARGET_GENERIC_HOSTNAME="swift-linux"
BR2_TARGET_GENERIC_ISSUE="Welcome to Swift Linux"

# Swift Runtime Libraries
BR2_PACKAGE_LIBDISPATCH=y
BR2_PACKAGE_SWIFT=y
BR2_PACKAGE_LIBSWIFTDISPATCH=y
BR2_PACKAGE_FOUNDATION=y

# Dependencies
BR2_PACKAGE_ICU=y
BR2_PACKAGE_LIBBSD=y
BR2_PACKAGE_LIBMD=y
BR2_PACKAGE_LIBXML2=y
BR2_PACKAGE_LIBCURL=y
BR2_PACKAGE_OPENSSL=y
```

## configs/swift_armv6_defconfig
```kconfig
# Architecture
BR2_arm=y
BR2_arm1176jzf_s=y
BR2_ARM_EABIHF=y

# GNU C Toolchain
BR2_KERNEL_HEADERS_4_19=y
BR2_TOOLCHAIN_BUILDROOT_GLIBC=y
BR2_TOOLCHAIN_BUILDROOT_CXX=y

# Vendor
BR2_TOOLCHAIN_BUILDROOT_VENDOR="swift"
BR2_TARGET_GENERIC_HOSTNAME="swift-linux"
BR2_TARGET_GENERIC_ISSUE="Welcome to Swift Linux"

# Swift Runtime Libraries
BR2_PACKAGE_LIBDISPATCH=y
BR2_PACKAGE_SWIFT=y
BR2_PACKAGE_LIBSWIFTDISPATCH=y
BR2_PACKAGE_FOUNDATION=y

# Dependencies
BR2_PACKAGE_ICU=y
BR2_PACKAGE_LIBBSD=y
BR2_PACKAGE_LIBMD=y
BR2_PACKAGE_LIBXML2=y
BR2_PACKAGE_LIBCURL=y
BR2_PACKAGE_OPENSSL=y
```

## configs/swift_mips_defconfig
```kconfig
# Architecture
BR2_mipsel=y
BR2_mips_32r6=y

# GNU C Toolchain
BR2_KERNEL_HEADERS_4_19=y
BR2_TOOLCHAIN_BUILDROOT_GLIBC=y
BR2_TOOLCHAIN_BUILDROOT_CXX=y

# Vendor
BR2_TOOLCHAIN_BUILDROOT_VENDOR="swift"
BR2_TARGET_GENERIC_HOSTNAME="swift-linux"
BR2_TARGET_GENERIC_ISSUE="Welcome to Swift Linux"

# Swift Runtime Libraries
BR2_PACKAGE_LIBDISPATCH=y
BR2_PACKAGE_SWIFT=y

# Dependencies
BR2_PACKAGE_ICU=y
BR2_PACKAGE_LIBBSD=y
BR2_PACKAGE_LIBMD=y
BR2_PACKAGE_LIBXML2=y
BR2_PACKAGE_LIBCURL=y
BR2_PACKAGE_OPENSSL=y
```

## configs/swift_riscv64_defconfig
```kconfig
# Architecture
BR2_riscv=y

# GNU C Toolchain
BR2_KERNEL_HEADERS_6_6=y
BR2_TOOLCHAIN_BUILDROOT_GLIBC=y
BR2_TOOLCHAIN_BUILDROOT_CXX=y

# Vendor
BR2_TOOLCHAIN_BUILDROOT_VENDOR="swift"
BR2_TARGET_GENERIC_HOSTNAME="swift-linux"
BR2_TARGET_GENERIC_ISSUE="Welcome to Swift Linux"

# Swift Runtime Libraries
BR2_PACKAGE_LIBDISPATCH=y
BR2_PACKAGE_SWIFT=y

# Dependencies
BR2_PACKAGE_ICU=y
BR2_PACKAGE_LIBBSD=y
BR2_PACKAGE_LIBMD=y
BR2_PACKAGE_LIBXML2=y
BR2_PACKAGE_LIBCURL=y
BR2_PACKAGE_OPENSSL=y
```

## package/Config.in
```kconfig
menu "Swift runtime"
	source "package/swift/Config.in"
    source "package/foundation/Config.in"
endmenu
menu "Swift libraries"
	source "package/xctest/Config.in"
endmenu
menu "Swift Tools"
	source "package/swift-hello/Config.in"
endmenu
```

## package/foundation/Config.in
```kconfig
if BR2_PACKAGE_SWIFT

config BR2_PACKAGE_FOUNDATION
	bool "foundation"
	depends on BR2_PACKAGE_SWIFT
	select BR2_PACKAGE_LIBSWIFTDISPATCH
	select BR2_PACKAGE_LIBCURL
	select BR2_PACKAGE_LIBXML2
	help
	  The Foundation framework defines a base layer of functionality that is required for almost all applications. It provides primitive classes and introduces several paradigms that define functionality not provided by either the Objective-C runtime and language or Swift standard library and language.

	  http://swift.org

endif
```

## package/libdispatch/Config.in
```kconfig
config BR2_PACKAGE_LIBDISPATCH_ARCH_SUPPORTS
	bool
	default y if BR2_x86_64
	default y if BR2_aarch64
	default y if BR2_arm
	default y if BR2_powerpc
	default y if BR2_powerpc64le
	default y if BR2_mips
	default y if BR2_mipsel
	default y if BR2_mips64
	default y if BR2_mips64el
	default y if BR2_RISCV_64

config BR2_PACKAGE_LIBDISPATCH_TARGET_ARCH
	string
	default "aarch64" if BR2_aarch64
	default "armv5" if BR2_ARM_CPU_ARMV5
	default "armv6" if BR2_ARM_CPU_ARMV6
	default "armv7" if BR2_ARM_CPU_ARMV7A
	default "x86_64" if BR2_x86_64
	default "powerpc" if BR2_powerpc
	default "powerpc64le" if BR2_powerpc64le
	default "mips" if BR2_mips
	default "mipsel" if BR2_mipsel
	default "mips64" if BR2_mips64
	default "mips64el" if BR2_mips64el
	default "riscv64" if BR2_RISCV_64

config BR2_PACKAGE_LIBDISPATCH
	bool "libdispatch"
	depends on BR2_PACKAGE_LIBDISPATCH_ARCH_SUPPORTS
	depends on BR2_TOOLCHAIN_HAS_THREADS
	depends on !BR2_STATIC_LIBS
	depends on BR2_TOOLCHAIN_USES_GLIBC
	select BR2_PACKAGE_LIBBSD
	
	help
	  Grand Central Dispatch (GCD or libdispatch) provides comprehensive support for concurrent code execution on multicore hardware.

	  http://swift.org

comment "libdispatch needs a toolchain w/ Glibc, wchar, threads, C++, dynamic library"
	depends on BR2_PACKAGE_LIBDISPATCH_ARCH_SUPPORTS
	depends on !BR2_TOOLCHAIN_USES_GLIBC || !BR2_TOOLCHAIN_HAS_THREADS || !BR2_INSTALL_LIBSTDCPP \
		|| BR2_STATIC_LIBS || !BR2_USE_WCHAR
```

## package/libswiftdispatch/Config.in
```kconfig
config BR2_PACKAGE_LIBSWIFTDISPATCH
	bool "libswiftdispatch"
	depends on BR2_TOOLCHAIN_HAS_THREADS
	depends on !BR2_STATIC_LIBS
	depends on BR2_TOOLCHAIN_USES_GLIBC
	depends on BR2_PACKAGE_LIBBSD
	depends on BR2_PACKAGE_SWIFT
	
	help
	  Swift overlay for libdispatch.

	  http://swift.org
```

## package/swift-hello/Config.in
```kconfig
if BR2_PACKAGE_SWIFT

config BR2_PACKAGE_SWIFT_HELLO
	bool "swift-hello"
	depends on BR2_PACKAGE_SWIFT
	select BR2_PACKAGE_SWIFT_FOUNDATION
	select BR2_PACKAGE_XCTEST
	help
	  Demo application for Swift.
	  
endif
```

## package/swift/Config.in
```kconfig
config BR2_PACKAGE_SWIFT_ARCH_SUPPORTS
	bool
	default y if BR2_x86_64
	default y if BR2_i386
	default y if BR2_aarch64
	default y if BR2_arm
	default y if BR2_powerpc
	default y if BR2_powerpc64le
	default y if BR2_mips
	default y if BR2_mipsel
	default y if BR2_mips64
	default y if BR2_mips64el
	default y if BR2_RISCV_64

config BR2_PACKAGE_SWIFT_TARGET_ARCH
	string
	default "aarch64" if BR2_aarch64
	default "armv5" if BR2_ARM_CPU_ARMV5
	default "armv6" if BR2_ARM_CPU_ARMV6
	default "armv7" if BR2_ARM_CPU_ARMV7A
	default "x86_64" if BR2_x86_64
	default "i686" if BR2_i386
	default "powerpc" if BR2_powerpc
	default "powerpc64le" if BR2_powerpc64le
	default "mips" if BR2_mips
	default "mipsel" if BR2_mipsel
	default "mips64" if BR2_mips64
	default "mips64el" if BR2_mips64el
	default "riscv64" if BR2_RISCV_64

config BR2_PACKAGE_SWIFT
	bool "swift"
	depends on BR2_PACKAGE_SWIFT_ARCH_SUPPORTS
	depends on BR2_TOOLCHAIN_HAS_THREADS
	depends on !BR2_STATIC_LIBS
	depends on BR2_TOOLCHAIN_USES_GLIBC
	select BR2_PACKAGE_ICU
	select BR2_PACKAGE_LIBDISPATCH
	help
	  Swift is a general-purpose programming language built using a modern approach to safety, performance, and software design patterns.

	  http://swift.org

if BR2_PACKAGE_SWIFT || BR2_PACKAGE_LIBDISPATCH

config BR2_PACKAGE_SWIFT_NATIVE_TOOLS
	string "Path to host Swift toolchain"
	default "/usr/bin"

config BR2_PACKAGE_SWIFT_LLVM_DIR
	string "Path to host LLVM library path"
	default "/usr/lib/llvm-12"

endif

comment "swift needs a toolchain w/ Glibc, ICU, wchar, threads, C++, dynamic library"
	depends on BR2_PACKAGE_SWIFT_ARCH_SUPPORTS
	depends on !BR2_TOOLCHAIN_USES_GLIBC || !BR2_TOOLCHAIN_HAS_THREADS || !BR2_INSTALL_LIBSTDCPP \
		|| BR2_STATIC_LIBS || !BR2_USE_WCHAR
```

## package/xctest/Config.in
```kconfig
if BR2_PACKAGE_SWIFT

config BR2_PACKAGE_XCTEST
	bool "xctest"
	depends on BR2_PACKAGE_SWIFT
	select BR2_PACKAGE_FOUNDATION
	help
	  The XCTest library is designed to provide a common framework for writing unit tests in Swift, for Swift packages and applications.

	  http://swift.org

endif
```
